## drivers/rekernel/Kconfig
```kconfig
menu "Re:Kernel"

config REKERNEL
	bool "Re:Kernel support"
	default y
	help
	  Make tombstone users get a better experience by reporting
	  Binder transactions, signals, and network packets targeting
	  frozen tasks via Netlink.

config REKERNEL_NETWORK
	bool "Re:Kernel NetReceive unfreeze support"
	depends on REKERNEL
	default n
	help
	  Notify user-space tombstone daemon when incoming TCP data
	  arrives for a frozen user application.

endmenu
```

## security/baseband-guard/Kconfig
```kconfig
menu "Baseband Security Guard Configuration"

config BBG
	bool "Enable Baseband Guard (Anti-Format)"
	default y
	depends on SECURITY
	help
	  An Android baseband anti-formatting protector module preventing
	  malicious scripts or programs from writing into critical baseband
	  and bootloader partitions.

config BBG_BLOCK_BOOT
	bool "Enable Baseband Protection for Boot Partition"
	depends on BBG
	default n

config BBG_BLOCK_RECOVERY
	bool "Enable Baseband Protection for Recovery Partition"
	depends on BBG
	default n

endmenu
```
